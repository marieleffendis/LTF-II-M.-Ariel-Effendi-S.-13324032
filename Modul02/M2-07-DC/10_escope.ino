/*
 * Konstanta dan fungsi dasar escope
 */

// Pin Standar kit ESCOPE 2020 ESP32
// Sudah terinclude dari library TFScope22

#define DA_MAX 255
#define AD_MAX 4095

// KONVERSI dgn Kalibrasi
// index kolom array kalibrasi
enum {I_AD, I_MV, I_DA, N_COL};
#define N_ROW 256

// isi tabel ini dari hasil program sebelumnya
int tabel[N_ROW][N_COL] = {
{   0,   87,    0},
{   1,   99,    1},
{   2,  112,    2},
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{4095, 3164,  255},
};


// Fungsi konversi
int mvToDa(int mv) {
  // konversi linier
  int ofs_mv = tabel[0][I_MV];
  float delta_mv = (float)tabel[N_ROW-1][I_MV]-ofs_mv;
  float delta_da = (float)tabel[N_ROW-1][I_DA];

  // kalkulasi pakai float, potong jadi int lagi
  int da = (int)((mv - ofs_mv) * delta_da / delta_mv);

  return constrain(da,0,DA_MAX);
}

// cari row yang isi AD nya sudah > ad
// return index antara 1 - (N_ROW-1)
int findIdx(int ad) {
  int i;
  for (i=1; i<N_ROW-1; i++) {
    if (tabel[i][I_AD] >= ad) break;    
  }
  return i;
}

// Fungsi konversi
int adToMv(int ad) {
  int idx = findIdx(ad);

  // konversi look-up table
  // interpolasi linier
  int ofs_ad = tabel[idx-1][I_AD];
  int ofs_mv = tabel[idx-1][I_MV];
  float delta_mv = (float)tabel[idx][I_MV]-ofs_mv;
  float delta_ad = (float)tabel[idx][I_AD]-ofs_ad;

  int mv = (int)((ad-ofs_ad) * delta_mv / delta_ad + 0.5) + ofs_mv;  

  return mv;
}

// DigitalToAnalog
void dacWriteMv(int pin, int mv) {
  dacWrite(pin, mvToDa(mv));
}

// DigitalToAnalog
int analogReadMv(int pin) {
  return adToMv(analogRead(pin));
}

// INA219
Adafruit_INA219 ina219;

int inaReadLoadMv() {
  float shunt_mv = ina219.getShuntVoltage_mV();
  float bus_v = ina219.getBusVoltage_V();    
  return (int) (shunt_mv + bus_v * 1000 + 0.5);      
}

int inaReadBusMv() {
  float bus_v = ina219.getBusVoltage_V();    
  return (int) (bus_v * 1000 + 0.5);      
}

// OLED
// pesan obyek display
#define D_WIDTH   128 
#define D_HEIGHT  32 
#define D_RESET   4
#define D_ADDR    0x3C
Adafruit_SSD1306 oled(D_WIDTH, D_HEIGHT, &Wire, D_RESET);

void oledPrint(int x, int y, char *str) {
  oled.setCursor(x,y);
  oled.print(str);
  oled.display();  
}

void oledBlink(int x, int y, char *str) {
  static bool dblink=true;
  if (dblink) {
    oled.setCursor(x,y);
    oled.print(str);
  }
  else {
    oled.clearDisplay();    
  }
  oled.display();
  dblink != dblink;
  delay(500);
}

// LED
void ledBlink() {
  static bool dled=true;
  digitalWrite(LED0, dled);
  dled=!dled;
}

void escopeSetup() {
  // siapkan OLED
  if(!oled.begin(SSD1306_SWITCHCAPVCC, D_ADDR)) {
    for(;;); 
  }
  oled.setTextColor(WHITE);
  oled.clearDisplay();
  oled.display();
  
  // siapkan INA219
  if (!ina219.begin()) {
    while (1) { delay(100); }
  }   

  // siapkan button
  pinMode(BT0, INPUT_PULLUP);
  pinMode(BT1, INPUT_PULLUP);
  pinMode(BT2, INPUT_PULLUP);

  // siapkan LED
  pinMode(LED0, OUTPUT);
  digitalWrite(LED0, LOW);
}

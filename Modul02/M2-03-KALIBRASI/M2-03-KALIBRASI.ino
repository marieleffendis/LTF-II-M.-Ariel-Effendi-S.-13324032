/* Program : DA_INA_AD
 * DA mengeluarkan sinyal ramp dalam mV
 * INA dan AD mengukur
 * Print ke Serial Monitor dalam mV
 * (c) Eko M. Budi, 2022
 */

// pustaka
#include <Wire.h>
#include <Adafruit_INA219.h>
#include <TFScope22.h>

#define BAUD 500000

// Pin Standar kit ESCOPE 2020 ESP32
// sudah terinclude di library TFScope22

#define DA_MAX 255
#define AD_MAX 4095

// pesan obyek INA219
Adafruit_INA219 ina219;

// data
int da_out; 
int ad_in;

int ina_mv;
int da_mv;
int ad_mv;

// KONVERSI dgn Kalibrasi

// index kolom array kalibrasi
enum {I_AD, I_MV, I_DA, N_COL};
#define N_ROW 256

// isi tabel ini dari hasil program sebelumnya
int tabel[N_ROW][N_COL] = {
{   0,   87,    0},
{   1,   96,    1},
{   4,  108,    2},
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{4095, 3160,  255},
};

// Fungsi konversi
int mvToDa(int mv) {
  // konversi linier
  int ofs_mv = tabel[0][I_MV];
  long delta_mv = tabel[N_ROW-1][I_MV]-ofs_mv;
  long delta_da = tabel[N_ROW-1][I_DA];

  // kalkulasi pakai long, bulatkan jadi int lagi
  int da =(int)(((float)(mv - ofs_mv) * delta_da / delta_mv) + 0.5); // INI MASIH SALAH !!

//  char buff[50];
//  sprintf(buff,"%4d %6.2f %6.2f %4d", mv, delta_mv, delta_da, da);
//  Serial.println(buff);
//  
  
  return constrain(da,0,DA_MAX);
}

// Fungsi konversi
int adToMv(int ad) {
  // cari segmen
  // berupa index pada tabel yang isi I_AD nya sudah > ad
  int idx;
  for (idx=1; idx<N_ROW-1; idx++) {
    if (tabel[idx][I_AD] >= ad) break;    
  }

  // ambil batas interpolasi dari tabel
  int ofs_ad = tabel[idx-1][I_AD];
  int ofs_mv = tabel[idx-1][I_MV];
  int delta_mv = (float)tabel[idx][I_MV]-ofs_mv;
  int delta_ad = (float)tabel[idx][I_AD]-ofs_ad;

  // interpolasi linier untuk konversi ke mV
  if (delta_ad == 0) {
    return ofs_mv; 
  }
  // Rumus Interpolasi: y = y0 + (x - x0) * (y1 - y0) / (x1 - x0)
  float mv = ofs_mv + (float)(ad - ofs_ad) * delta_mv / delta_ad;
  
  return (int)(mv + 0.5);
//  char buff[60];
//  sprintf(buff,"%4d %4d %4d %5.2f %5.2f %4d", ad, ofs_mv, ofs_ad, delta_mv, delta_ad, idx);
//  Serial.println(buff);
// 
}

// Fungsi untuk print data ke serial monitor
void printData() {
  char buff[40];
  // format ke spreadsheet
  sprintf(buff,"%3d %5d  %6d  %5d", da_out, da_mv, ina_mv, ad_mv);
  Serial.println(buff);
}

// UTAMA
void setup() {
  // Siapkan serial, tunggu sampai terkoneksi
  Serial.begin(BAUD);
  while (!Serial) {}
  Serial.println("\nAnalog I/O Terkalibrasi");  

  // siapkan INA219
  if (!ina219.begin()) {
    while (1) { delay(100); }
  }  
}

void loop() {
  // Header Plot
  Serial.println("DA  DA(mV) Vi+(mV) AD(mV)");

  // mengeluarkan output ramp 
  for (da_mv=0; da_mv<=3300; da_mv += 50) {
    // keluarkan sinyal ke DA
    da_out = mvToDa(da_mv);
    dacWrite(AO0, da_out);
    delay(10);    // tunggu tunak

    // baca AD
    ad_in = analogRead(DI0);
    ad_mv = adToMv(ad_in);

    // baca INA 
    float shunt_mv = ina219.getShuntVoltage_mV();
    float bus_v = ina219.getBusVoltage_V();    

    // konversi bacaan ina ke tegangan (mV)
    ina_mv = (int) (shunt_mv + (bus_v * 1000)+ 0.5); // INI MASIH SALAH
    
    printData();    
  }
  
  // tunggu sampai dikirimi sesuatu dari Serial monitor
  Serial.println("Kirim sembarang huruf untuk ukur lagi");
  while(!Serial.available());
  while(Serial.available()) Serial.read();
}
